## conf/layer.conf
```bitbake
# We have a conf and classes directory, append to BBPATH
BBPATH .= ":${LAYERDIR}"

BBFILES += "${LAYERDIR}/recipes-*/*/*.bb ${LAYERDIR}/appends/*/*.bbappend"

BBFILE_COLLECTIONS += "office-layer"
BBFILE_PATTERN_office-layer := "^${LAYERDIR}/"
BBFILE_PRIORITY_office-layer = "7"

LAYERDEPENDS_office-layer = " \
    core \
    openembedded-layer \
    meta-python \
    gnome-layer \
    networking-layer \
"

LAYERSERIES_COMPAT_office-layer = "dunfell gatesgarth hardknott"

SIGGEN_EXCLUDE_SAFE_RECIPE_DEPS += " \
    libreoffice-dictionaries->hunspell \
"
```
